// SPDX-License-Identifier: GPL-2.0
/dts-v1/;
/plugin/;

/*
 * ROCK 5B Profile-D experimental USB gadget routing.
 *
 * This overlay is deliberately board-specific. The ROCK 5B routes the
 * RK3588 fc400000 DWC3 controller to the lower blue USB-A connector and
 * normally configures that path as a host.
 *
 * Profile-D test mode changes that connector into a fixed USB gadget port:
 *   - fc400000 is forced to peripheral mode;
 *   - shared host VBUS and the other USB host PHYs remain unchanged;
 *   - u2phy1 uses software VBUS-valid because this Type-A routing does not
 *     expose a usable device-mode BVALID signal to the PHY; and
 *   - usbdp_phy1 forces the RK3588 hardware BVALID override that a normal
 *     Type-C orientation event would otherwise program.
 *
 * Connecting this USB-A gadget port to a host requires an inline adapter
 * that disconnects VBUS (5 V) while retaining USB data and ground.
 * USB_HOST_PWREN_H controls both USB-A connector pairs; disabling it also
 * removes power from the other host ports. Do not use a charge-only/data
 * blocker adapter: the data connection must remain intact.
 *
 * The software VBUS-valid and fixed-peripheral BVALID properties require
 * the matching board-builder kernel patches. usb@fc000000 and HDMI-RX are
 * intentionally untouched.
 */

/ {
    fragment@0 {
        target-path = "/usb@fc400000";

        __overlay__ {
            dr_mode = "peripheral";
            snps,dis_u2_susphy_quirk;
        };
    };

    fragment@1 {
        target-path = "/syscon@fd5d4000/usb2phy@4000/otg-port";

        __overlay__ {
            rockchip,vbus-always-on;
        };
    };
    fragment@2 {
        target-path = "/phy@fed90000";

        __overlay__ {
            rockchip,fixed-peripheral-bvalid;
        };
    };

};
