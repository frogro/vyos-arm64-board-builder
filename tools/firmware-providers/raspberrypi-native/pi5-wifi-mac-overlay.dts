// SPDX-License-Identifier: GPL-2.0
/dts-v1/;
/plugin/;

/ {
    compatible = "raspberrypi,5-model-b", "brcm,bcm2712";

    fragment@0 {
        target-path = "/soc@107c000000/mmc@1100000/wifi@1";

        wifi: __overlay__ {
            local-mac-address = [00 00 00 00 00 00];
        };
    };

    fragment@1 {
        target-path = "/";

        __overlay__ {
            aliases {
                wifi0 = "/soc@107c000000/mmc@1100000/wifi@1";
            };

            __overrides__ {
                wifiaddr = <&wifi>, "local-mac-address[";
            };
        };
    };
};
